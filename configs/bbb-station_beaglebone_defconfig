## configs/bbb-station_beaglebone_defconfig
```kconfig
BR2_arm=y
BR2_cortex_a8=y
BR2_DL_DIR="../dl"
BR2_CCACHE=y
BR2_CCACHE_INITIAL_SETUP="-o temporary_dir=$${TMP:-/tmp}"
BR2_PACKAGE_OVERRIDE_FILE="$(BR2_EXTERNAL_BBB_STATION_PATH)/local.mk"
BR2_GLOBAL_PATCH_DIR="../patches"
BR2_PACKAGE_HOST_LINUX_HEADERS_CUSTOM_4_19=y
BR2_TOOLCHAIN_BUILDROOT_WCHAR=y
BR2_PTHREADS=y
BR2_TOOLCHAIN_BUILDROOT_CXX=y
BR2_GCC_ENABLE_LTO=y
BR2_TARGET_GENERIC_HOSTNAME="bbb-station"
BR2_TARGET_GENERIC_ISSUE="Welcome to BBB-Station"
BR2_ROOTFS_DEVICE_CREATION_DYNAMIC_MDEV=y
BR2_ROOTFS_DEVICE_TABLE="$(BR2_EXTERNAL_BBB_STATION_PATH)/device_table.txt"
BR2_ROOTFS_MERGED_USR=y
BR2_TARGET_GENERIC_GETTY_PORT="ttyS0"
BR2_TARGET_GENERIC_GETTY_BAUDRATE_115200=y
BR2_TARGET_GENERIC_GETTY_TERM="linux"
BR2_ENABLE_LOCALE_WHITELIST="en_US.utf8 C"
BR2_TARGET_TZ_INFO=y
BR2_TARGET_LOCALTIME="Europe/Brussels"
BR2_ROOTFS_OVERLAY="../projects/common/fs-overlay $(BR2_EXTERNAL_BBB_STATION_PATH)/fs-overlay"
BR2_ROOTFS_POST_BUILD_SCRIPT="$(BR2_EXTERNAL_BBB_STATION_PATH)/post-build-hook"
BR2_ROOTFS_POST_IMAGE_SCRIPT="$(BR2_EXTERNAL_BBB_STATION_PATH)/post-image-hook ../board/beaglebone/post-image-hook"
BR2_LINUX_KERNEL=y
BR2_LINUX_KERNEL_CUSTOM_GIT=y
BR2_LINUX_KERNEL_CUSTOM_REPO_URL="git@github.com:beagleboard/linux.git"
BR2_LINUX_KERNEL_CUSTOM_REPO_VERSION="4.19.31-ti-r18"
BR2_LINUX_KERNEL_PATCH="../board/beaglebone/patches/linux"
BR2_LINUX_KERNEL_USE_CUSTOM_CONFIG=y
BR2_LINUX_KERNEL_CUSTOM_CONFIG_FILE="../board/beaglebone/linux.defconfig"
BR2_LINUX_KERNEL_DTS_SUPPORT=y
BR2_LINUX_KERNEL_CUSTOM_DTS_PATH="../board/beaglebone/bbb-station.dts"
BR2_PACKAGE_LINUX_TOOLS_CPUPOWER=y
BR2_PACKAGE_LINUX_TOOLS_GPIO=y
BR2_PACKAGE_LINUX_TOOLS_IIO=y
BR2_PACKAGE_BUSYBOX_CONFIG="$(BR2_EXTERNAL_BBB_STATION_PATH)/busybox.config"
BR2_PACKAGE_XZ=y
BR2_PACKAGE_ZIP=y
BR2_PACKAGE_TREE=y
BR2_PACKAGE_18XX_TI_UTILS=y
BR2_PACKAGE_IOSTAT=y
BR2_PACKAGE_LM_SENSORS=y
BR2_PACKAGE_LM_SENSORS_FANCONTROL=y
BR2_PACKAGE_LM_SENSORS_PWMCONFIG=y
BR2_PACKAGE_PHP=y
BR2_PACKAGE_PHP_EXT_BZIP2=y
BR2_PACKAGE_PHP_EXT_OPENSSL=y
BR2_PACKAGE_PHP_EXT_PDO=y
BR2_PACKAGE_PHP_EXT_PDO_SQLITE=y
BR2_PACKAGE_PHP_EXT_JSON=y
BR2_PACKAGE_PHP_EXT_CURL=y
BR2_PACKAGE_NCURSES_WCHAR=y
BR2_PACKAGE_PCRE_UTF=y
BR2_PACKAGE_DROPBEAR=y
BR2_PACKAGE_DROPBEAR_WTMP=y
BR2_PACKAGE_DROPBEAR_LASTLOG=y
BR2_PACKAGE_HOSTAPD=y
# BR2_PACKAGE_HOSTAPD_VLAN is not set
BR2_PACKAGE_IPTABLES=y
BR2_PACKAGE_LIGHTTPD=y
BR2_PACKAGE_LIGHTTPD_OPENSSL=y
BR2_PACKAGE_LIGHTTPD_ZLIB=y
BR2_PACKAGE_LIGHTTPD_BZIP2=y
BR2_PACKAGE_LIGHTTPD_PCRE=y
BR2_PACKAGE_LIGHTTPD_WEBDAV=y
BR2_PACKAGE_NTP=y
# BR2_PACKAGE_NTP_NTPD is not set
BR2_PACKAGE_NTP_NTPDATE=y
BR2_PACKAGE_RSYNC=y
BR2_PACKAGE_TCPDUMP=y
BR2_PACKAGE_TRACEROUTE=y
BR2_PACKAGE_WPA_SUPPLICANT=y
BR2_PACKAGE_WPA_SUPPLICANT_AUTOSCAN=y
BR2_PACKAGE_WPA_SUPPLICANT_DEBUG_SYSLOG=y
BR2_PACKAGE_WPA_SUPPLICANT_CLI=y
BR2_PACKAGE_WPA_SUPPLICANT_WPA_CLIENT_SO=y
BR2_PACKAGE_WPA_SUPPLICANT_PASSPHRASE=y
BR2_PACKAGE_AT=y
BR2_PACKAGE_FILE=y
BR2_PACKAGE_INOTIFY_TOOLS=y
BR2_PACKAGE_SUDO=y
BR2_PACKAGE_HTOP=y
BR2_PACKAGE_UTIL_LINUX=y
BR2_PACKAGE_UTIL_LINUX_BINARIES=y
BR2_PACKAGE_JOE=y
BR2_TARGET_ROOTFS_EXT2=y
BR2_TARGET_ROOTFS_EXT2_4=y
BR2_TARGET_ROOTFS_EXT2_SIZE="512M"
BR2_TARGET_UBOOT=y
BR2_TARGET_UBOOT_BUILD_SYSTEM_KCONFIG=y
BR2_TARGET_UBOOT_CUSTOM_VERSION=y
BR2_TARGET_UBOOT_CUSTOM_VERSION_VALUE="2018.01"
BR2_TARGET_UBOOT_BOARD_DEFCONFIG="am335x_boneblack"
BR2_TARGET_UBOOT_NEEDS_DTC=y
# BR2_TARGET_UBOOT_FORMAT_BIN is not set
BR2_TARGET_UBOOT_FORMAT_IMG=y
BR2_TARGET_UBOOT_SPL=y
BR2_TARGET_UBOOT_SPL_NAME="MLO"
BR2_PACKAGE_HOST_DOSFSTOOLS=y
BR2_PACKAGE_HOST_GENIMAGE=y
BR2_PACKAGE_HOST_MTOOLS=y
BR2_PACKAGE_SGP30=y
```

## package/Config.in
```kconfig
source "../package/bbbwl-firmwares/Config.in"
source "../package/sgp30/Config.in"
```

## package/bbbwl-firmwares/Config.in
```kconfig
config BR2_PACKAGE_BBBWL_FIRMWARES
	bool "Beagle Bone Black Wireless Firmwares"
	default y
	select BR2_PACKAGE_LINUX_FIRMWARE
	select BR2_PACKAGE_LINUX_FIRMWARE_TI_WL18XX
```

## package/sgp30/Config.in
```kconfig
config BR2_PACKAGE_SGP30
	bool "sgp30/sgpc3"
	depends on BR2_LINUX_KERNEL
	help
          I2C interface support for the following
          Sensirion SGP multi-pixel gas sensors:

            * SGP30 gas sensor
            * SGPC3 low power gas sensor

          This module will be called sgp30.

	  Requires CONFIG_CRC8 & CONFIG_IIO

comment "sgp30/sgpc3 needs a Linux kernel to be built"
        depends on !BR2_LINUX_KERNEL
```
